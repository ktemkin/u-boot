/dts-v1/;

#include "tegra210.dtsi"

/ {
	model = "Google Tegra210 Smaug Rev 1,3+";
	compatible = "google,smaug-rev8", "google,smaug-rev7",
		     "google,smaug-rev6", "google,smaug-rev5",
		     "google,smaug-rev4", "google,smaug-rev3",
		     "google,smaug-rev1", "google,smaug", "nvidia,tegra210";

	chosen {
		stdout-path = &uarta;
	};

	memory {
		device_type = "memory";
		/* TODO: replace */
		reg = < 0x0 0x80000000 0x0 0x7d200000 >,
		      < 0x1 0x00000000 0x0 0x40000000 >;
	};

};
