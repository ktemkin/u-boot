## board/nvidia/pixelc/Kconfig
```kconfig
if TARGET_PIXELC

config SYS_BOARD
	default "pixelc"

config SYS_VENDOR
	default "nvidia"

config SYS_CONFIG_NAME
	default "pixelc"

endif
```

## configs/pixelc_defconfig
```kconfig
CONFIG_ARM=y
CONFIG_TEGRA=y
CONFIG_TEGRA210=y
CONFIG_TARGET_PIXELC=y
CONFIG_DEFAULT_DEVICE_TREE="tegra210-smaug"
CONFIG_SYS_PROMPT="Tegra210 (PixelC) # "
CONFIG_SPL_DM=y
CONFIG_USB=y
CONFIG_DM_USB=y
CONFIG_USE_PRIVATE_LIBGCC=y
```
